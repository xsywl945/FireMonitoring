#include <Arduino.h>
#include <Wire.h>
#include <string.h>

#include "display.h"

constexpr uint8_t SCREEN_ADDRESS = 0x3C;
constexpr int SCREEN_WIDTH = 128;

// 5x7 glyphs, bits top to bottom in each column. Index is ASCII - 32.
static const uint8_t GLYPHS[][5] = {
    {0x00, 0x00, 0x00, 0x00, 0x00}, {0x00, 0x00, 0x5f, 0x00, 0x00}, {0x00, 0x07, 0x00, 0x07, 0x00},
    {0x14, 0x7f, 0x14, 0x7f, 0x14}, {0x24, 0x2a, 0x7f, 0x2a, 0x12}, {0x23, 0x13, 0x08, 0x64, 0x62},
    {0x36, 0x49, 0x55, 0x22, 0x50}, {0x00, 0x05, 0x03, 0x00, 0x00}, {0x00, 0x1c, 0x22, 0x41, 0x00},
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    {0x44, 0x64, 0x54, 0x4c, 0x44},
};

uint8_t frame[8][SCREEN_WIDTH];

void command(uint8_t value) {
  Wire.beginTransmission(SCREEN_ADDRESS);
  Wire.write(0x00);
  Wire.write(value);
  Wire.endTransmission();
}

void displayBegin() {
  Wire.begin(21, 22);
  static const uint8_t init[] = {0xAE, 0xD5, 0x80, 0xA8, 0x3F, 0xD3, 0x00, 0x40, 0x8D, 0x14,
                                 0x20, 0x00, 0xA1, 0xC8, 0xDA, 0x12, 0x81, 0xCF, 0xD9, 0xF1,
                                 0xDB, 0x40, 0xA4, 0xA6, 0xAF};
  for (uint8_t value : init) command(value);
  memset(frame, 0, sizeof(frame));
}

void drawText(int page, const char* text) {
  int column = 0;
  for (const char* cursor = text; *cursor && column < SCREEN_WIDTH - 6; ++cursor) {
    int index = static_cast<unsigned char>(*cursor) - 32;
    if (index < 0 || index >= static_cast<int>(sizeof(GLYPHS) / sizeof(GLYPHS[0]))) index = 0;
    for (int i = 0; i < 5; ++i) frame[page][column++] = GLYPHS[index][i];
    frame[page][column++] = 0;
  }
}

void flushFrame() {
  for (int page = 0; page < 8; ++page) {
    command(static_cast<uint8_t>(0xB0 + page));
    command(0x00);
    command(0x10);
    for (int column = 0; column < SCREEN_WIDTH; column += 16) {
      Wire.beginTransmission(SCREEN_ADDRESS);
      Wire.write(0x40);
      for (int i = 0; i < 16; ++i) Wire.write(frame[page][column + i]);
      Wire.endTransmission();
    }
  }
}

void displayShow(const char* line1, const char* line2) {
  memset(frame, 0, sizeof(frame));
  drawText(0, line1);
  drawText(2, line2);
  flushFrame();
}
